## CMakeLists.txt
```
cmake_minimum_required(VERSION 3.20.0)
find_package(Zephyr REQUIRED HINTS $ENV{ZEPHYR_BASE})
project(libpeer_test)

target_sources(app PRIVATE src/main.c)

zephyr_include_directories(${APPLICATION_SOURCE_DIR}/src/configs)
```

## Kconfig
```
config LIBPEER_SAMPLE_LOG_LEVEL
	int "Default log level for the libpeer_integration app"
	default 4

source "Kconfig.zephyr"
```

## prj.conf
```kconfig
# Logging
CONFIG_LOG=y
CONFIG_PRINTK=y

CONFIG_LIBPEER_SAMPLE_LOG_LEVEL=3

# Shell
CONFIG_SHELL=y

# Kernel options
CONFIG_MAIN_STACK_SIZE=8192
# CONFIG_ENTROPY_GENERATOR=y
CONFIG_TEST_RANDOM_GENERATOR=y
CONFIG_INIT_STACKS=y
CONFIG_COMMON_LIBC_MALLOC=y
#CONFIG_HEAP_MEM_POOL_SIZE=131072
CONFIG_HEAP_MEM_POOL_SIZE=18432
CONFIG_COMMON_LIBC_MALLOC_ARENA_SIZE=32768

# Generic networking options
CONFIG_NETWORKING=y
CONFIG_NET_UDP=y
CONFIG_NET_TCP=y
CONFIG_NET_IPV4=y
CONFIG_NET_SOCKETS=y
CONFIG_NET_SOCKETS_TLS_MAX_APP_PROTOCOLS=1
CONFIG_NET_SOCKETS_SOCKOPT_TLS=y
CONFIG_NET_SOCKETS_TLS_MAX_CONTEXTS=10
CONFIG_POSIX_API=y
CONFIG_NET_CONNECTION_MANAGER=y
CONFIG_NET_SHELL=y
CONFIG_ZVFS_POLL_MAX=4
# CONFIG_NET_LOG=y
# CONFIG_NET_CORE_LOG_LEVEL_DBG=y
# CONFIG_NET_TCP_LOG_LEVEL_DBG=y
# CONFIG_NET_CONTEXT_LOG_LEVEL_DBG=y
# CONFIG_NET_SOCKETS_LOG_LEVEL_DBG=y

# Network buffers
CONFIG_NET_PKT_RX_COUNT=16
CONFIG_NET_PKT_TX_COUNT=16
CONFIG_NET_BUF_RX_COUNT=64
CONFIG_NET_BUF_TX_COUNT=64
CONFIG_NET_CONTEXT_NET_PKT_POOL=y

# IP address options
CONFIG_NET_MAX_CONTEXTS=12

# Default network configuration
CONFIG_DNS_RESOLVER=y
CONFIG_DNS_SERVER_IP_ADDRESSES=y
CONFIG_DNS_SERVER1="8.8.8.8"

# Libpeer options
CONFIG_LIBPEER=y
CONFIG_LIBPEER_LOG_LEVEL_OFF=y
CONFIG_LIBPEER_AGENT_CONNCHECK_MAX=100
CONFIG_LIBPEER_AGENT_CONNCHECK_PERIOD=50

# JSON
# CONFIG_JSON_LIBRARY=y

# MQTT
CONFIG_MQTT_LIB=y
CONFIG_MQTT_LIB_TLS=y
CONFIG_MQTT_KEEPALIVE=60
# CONFIG_MQTT_LOG_LEVEL_DBG=y

# Use mDNS to resolve obfuscated local ICE candidate addresses
CONFIG_MDNS_RESOLVER=y
# CONFIG_DNS_RESOLVER_LOG_LEVEL_DBG=y
# CONFIG_NET_SOCKETS_LOG_LEVEL_DBG=y

# PSA and Mbedtls
CONFIG_PSA_CRYPTO=y
CONFIG_PSA_WANT_KEY_TYPE_AES=y
CONFIG_PSA_WANT_KEY_TYPE_ECC_PUBLIC_KEY=y
CONFIG_PSA_WANT_KEY_TYPE_ECC_KEY_PAIR_IMPORT=y
CONFIG_PSA_WANT_KEY_TYPE_ECC_KEY_PAIR_EXPORT=y
CONFIG_PSA_WANT_KEY_TYPE_ECC_KEY_PAIR_GENERATE=y
CONFIG_PSA_WANT_KEY_TYPE_ECC_KEY_PAIR_DERIVE=y
CONFIG_PSA_WANT_ECC_SECP_R1_256=y
CONFIG_PSA_WANT_ECC_SECP_R1_384=y
CONFIG_PSA_WANT_ECC_SECP_R1_521=y
CONFIG_PSA_WANT_ECC_MONTGOMERY_255=y
CONFIG_PSA_WANT_ECC_MONTGOMERY_448=y

CONFIG_PSA_WANT_ALG_ECDH=y
CONFIG_PSA_WANT_ALG_ECDSA=y
CONFIG_PSA_WANT_ALG_GCM=y
CONFIG_PSA_WANT_ALG_MD5=y
CONFIG_PSA_WANT_ALG_SHA_1=y
CONFIG_PSA_WANT_ALG_SHA_224=y
CONFIG_PSA_WANT_ALG_SHA_256=y
CONFIG_PSA_WANT_ALG_SHA_384=y
CONFIG_PSA_WANT_ALG_SHA_512=y
CONFIG_PSA_WANT_ALG_RSA_PKCS1V15_SIGN=y

CONFIG_MBEDTLS=y
CONFIG_MBEDTLS_ENABLE_HEAP=y
CONFIG_MBEDTLS_HEAP_SIZE=65536
CONFIG_MBEDTLS_SSL_IN_CONTENT_LEN=16384
CONFIG_MBEDTLS_SSL_OUT_CONTENT_LEN=2048
CONFIG_MBEDTLS_INIT=y
CONFIG_MBEDTLS_SHELL=y
CONFIG_MBEDTLS_USER_CONFIG_FILE="mbedtls_libpeer_config.h"
CONFIG_MBEDTLS_SSL_ALPN=y
CONFIG_MBEDTLS_SSL_SERVER_NAME_INDICATION=y
CONFIG_MBEDTLS_BUILTIN=y
# CONFIG_MBEDTLS_DEBUG=y
# CONFIG_MBEDTLS_DEBUG_C=y
# CONFIG_MBEDTLS_MEMORY_DEBUG=y
# CONFIG_MBEDTLS_LOG_LEVEL_DBG=y

CONFIG_MBEDTLS_X509_CRT_PARSE_C=y
CONFIG_MBEDTLS_X509_CRT_WRITE_C=y
CONFIG_MBEDTLS_X509_CSR_PARSE_C=y
CONFIG_MBEDTLS_X509_CSR_WRITE_C=y
CONFIG_MBEDTLS_PK_WRITE_C=y
CONFIG_MBEDTLS_PEM_WRITE_C=y
CONFIG_MBEDTLS_PEM_PARSE_C=y
CONFIG_MBEDTLS_SSL_PROTO_DTLS=y

CONFIG_MBEDTLS_MD_C=y
CONFIG_MBEDTLS_HASH_ALL_ENABLED=y

CONFIG_MBEDTLS_SSL_PROTO_TLS1_2=y
CONFIG_MBEDTLS_KEY_EXCHANGE_ECDHE_PSK_ENABLED=y

CONFIG_MBEDTLS_CIPHERSUITE_TLS_ECDHE_ECDSA_WITH_AES_256_GCM_SHA384=y
CONFIG_MBEDTLS_CIPHERSUITE_TLS_ECDHE_ECDSA_WITH_AES_128_GCM_SHA256=y
CONFIG_MBEDTLS_CIPHERSUITE_TLS_ECDHE_RSA_WITH_AES_128_CBC_SHA256=y
CONFIG_MBEDTLS_CIPHERSUITE_TLS_ECDHE_RSA_WITH_AES_128_GCM_SHA256=y
CONFIG_MBEDTLS_CIPHERSUITE_TLS_ECDHE_RSA_WITH_AES_256_GCM_SHA384=y
CONFIG_MBEDTLS_CIPHERSUITE_TLS_ECDHE_ECDSA_WITH_AES_128_CCM_8=y
CONFIG_MBEDTLS_CIPHERSUITE_TLS_ECDHE_PSK_WITH_AES_256_CBC_SHA384=y
CONFIG_MBEDTLS_CIPHERSUITE_TLS_PSK_WITH_AES_128_GCM_SHA256=y
```

## boards/native_sim_native_64.conf
```kconfig
CONFIG_TEST_RANDOM_GENERATOR=y

# Use native offloaded sockets
CONFIG_ETH_NATIVE_TAP=n
CONFIG_NET_DRIVERS=y
CONFIG_NET_SOCKETS=y
CONFIG_NET_SOCKETS_OFFLOAD=y
CONFIG_NET_NATIVE_OFFLOADED_SOCKETS=y

# Default network configuration
CONFIG_NET_CONFIG_SETTINGS=y
CONFIG_NET_CONFIG_NEED_IPV4=y

# Network address
CONFIG_NET_CONFIG_MY_IPV4_ADDR="192.168.1.42"
CONFIG_NET_CONFIG_PEER_IPV4_ADDR="192.168.1.1"
CONFIG_NET_CONFIG_MY_IPV4_GW="192.168.1.1"
```

## boards/rpi_pico2_rp2350a_m33_0_w.conf
```kconfig
CONFIG_LOG_MODE_IMMEDIATE=y

CONFIG_WIFI=y
CONFIG_NET_L2_ETHERNET=y
CONFIG_NET_L2_WIFI_SHELL=y
CONFIG_ZVFS_POLL_MAX=8

CONFIG_NET_DHCPV4=y
CONFIG_NET_BUF_POOL_USAGE=y

CONFIG_NET_MGMT_EVENT_QUEUE_TIMEOUT=5000
CONFIG_NET_MGMT_EVENT_QUEUE_SIZE=16
```

## src/main.c
```c
/*
 * Copyright (c) 2026 Igalia S.L.
 *
 * SPDX-License-Identifier: Apache-2.0
 */

#include <zephyr/shell/shell.h>
#include "peer.h"

LOG_MODULE_REGISTER(libpeer_test, CONFIG_LIBPEER_SAMPLE_LOG_LEVEL);

#define WEBRTC_SIGNALING_SERVER "mqtts://broker.emqx.io/public/"
#define WEBRTC_TEST_WEB "https://sepfy.github.io/libpeer/?id="

PeerConnection* peer_conn;

static void iceconn_statechange_cb(PeerConnectionState state, void *user_data)
{
	LOG_INF("Connection state: %d", state);
}

int msg_idx = 0;

static void message_cb(char *msg, size_t len, void *userdata, uint16_t sid)
{
	if (strcmp(msg, "ping") == 0) {
		peer_connection_datachannel_send_sid(peer_conn, "pong",
						strlen("pong"), sid);
	} else {
		peer_connection_datachannel_send_sid(peer_conn, msg, len, sid);
	}
}

static void open_cb(void *userdata)
{
	LOG_DBG("Data channel open");
}

static void close_cb(void *userdata)
{
	LOG_DBG("Data channel closed");
}


#define THREAD_PRIORITY  5
#define SIGNALING_STACK  4096
#define CONNECTION_STACK  8192
K_THREAD_STACK_DEFINE(signaling_stack, SIGNALING_STACK);
static struct k_thread signaling_thread;
K_THREAD_STACK_DEFINE(connection_stack, CONNECTION_STACK);
static struct k_thread connection_thread;

extern int peer_signaling_loop(void);

static void signaling_thread_fn(void *p1, void *p2, void *p3)
{
	while (true) {
		if (peer_signaling_loop()) {
			k_msleep(10);
		}
	}
}

static void connection_thread_fn(void *p1, void *p2, void *p3)
{
	while (true) {
		peer_connection_loop(peer_conn);
		k_msleep(1);
	}
}


#define SIGNALING_ENDPOINT_MAX_LEN 256
static int libpeer_test(const struct shell *sh, size_t argc, char **argv)
{
	PeerConfiguration config = {
		.ice_servers = {
			{.urls = "stun:stun.l.google.com:19302"}},
		.audio_codec = CODEC_NONE,
		.video_codec = CODEC_NONE,
		.datachannel = DATA_CHANNEL_STRING,
	};
	char signaling_endpoint[SIGNALING_ENDPOINT_MAX_LEN] = {'\0'};

	peer_init();
	peer_conn = peer_connection_create(&config);
	if (!peer_conn) {
		LOG_ERR("peer_connection_create() failed");
		return 1;
	}
	peer_connection_oniceconnectionstatechange(peer_conn,
				iceconn_statechange_cb);
	peer_connection_ondatachannel(peer_conn, message_cb,
				open_cb, close_cb);
	snprintf(signaling_endpoint, sizeof(signaling_endpoint),
				WEBRTC_SIGNALING_SERVER "%s", argv[1]);
	LOG_INF("Open %s%s in a browser and click 'Connect'",
		WEBRTC_TEST_WEB, argv[1]);
	peer_signaling_connect(signaling_endpoint, "", peer_conn);

	k_thread_create(&signaling_thread, signaling_stack,
			K_THREAD_STACK_SIZEOF(signaling_stack),
			signaling_thread_fn, NULL, NULL, NULL,
			THREAD_PRIORITY, 0, K_NO_WAIT);
	k_thread_name_set(&signaling_thread, "signaling");
	k_thread_create(&connection_thread, connection_stack,
			K_THREAD_STACK_SIZEOF(connection_stack),
			connection_thread_fn, NULL, NULL, NULL,
			THREAD_PRIORITY, 0, K_NO_WAIT);
	k_thread_name_set(&connection_thread, "peer_connection");

	return 0;
}

SHELL_CMD_ARG_REGISTER(libpeer_test, NULL,
			"libpeer test <conn_id>\r\n"
			"Starts a WebRTC datachannel libpeer test",
			libpeer_test, 2, 0);

int main(void)
{
	return 0;
}
```
